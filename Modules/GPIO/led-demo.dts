/dts-v1/;
/plugin/;

/ {
	compatible = "brcm,bcm2712";
	fragment@0 {
		target-path = "/";
		__overlay__ {
			demo-led {
				compatible = "dishoungh,rpi5-gpio";
				led-gpios = <&rp1_gpio 5 0>; // 0 = ACTIVE_HIGH | 1 = ACTIVE_LOW
			};
		};
	};
};
